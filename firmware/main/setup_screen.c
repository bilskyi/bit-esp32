// See setup_screen.h for what this is and why it exists as its own file.
//
// FONT5X7 is the classic public-domain 5x7 bitmap font shipped as glcdfont.c
// in the Adafruit-GFX-Library (github.com/adafruit/Adafruit-GFX-Library),
// itself the "System font" used across the AVR LCD world since long before
// that. It stores 256 glyphs at 5 bytes each, one byte per column, bit 0 the
// top row; only the printable range 0x20-0x7e is kept here. A handful of
// descenders (g, p, q, y, comma) use an 8th bit below this font's baseline -
// this table only ever reads bits 0-6, so those glyphs draw flush with
// everyone else instead of dipping into an 8th row this panel does not budget
// for.

#include "setup_screen.h"

#include <string.h>

#define FONT_FIRST 0x20
#define FONT_LAST 0x7e

// clang-format off
static const uint8_t FONT5X7[95][5] = {
    {0x00, 0x00, 0x00, 0x00, 0x00},  // 0x20  .
    {0x00, 0x00, 0x5f, 0x00, 0x00},  // 0x21 !.
    {0x00, 0x07, 0x00, 0x07, 0x00},  // 0x22 ".
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    {0x02, 0x01, 0x02, 0x04, 0x02},  // 0x7e ~.
};
// clang-format on

static const uint8_t *glyph_for(char c) {
    unsigned char uc = (unsigned char)c;
    if (uc < FONT_FIRST || uc > FONT_LAST) uc = '?';
    return FONT5X7[uc - FONT_FIRST];
}

static void set_pixel(uint8_t *fb, int x, int y) {
    if (x < 0 || y < 0 || x >= FACE_W || y >= FACE_H) return;
    fb[(y / 8) * FACE_W + x] |= (uint8_t)(1u << (y % 8));
}

void ss_draw_text(uint8_t *fb, int x, int y, const char *text) {
    int cx = x;
    for (const char *p = text; *p != '\0' && cx < FACE_W; p++, cx += SS_ADVANCE) {
        const uint8_t *g = glyph_for(*p);
        for (int col = 0; col < SS_GLYPH_W; col++) {
            uint8_t bits = g[col];
            for (int row = 0; row < SS_GLYPH_H; row++) {
                if (bits & (1u << row)) set_pixel(fb, cx + col, y + row);
            }
        }
    }
}

const char *ss_status_text(ss_status_t status) {
    switch (status) {
        case SS_STATUS_WAITING: return "waiting";
        case SS_STATUS_TRYING: return "connecting...";
        case SS_STATUS_CONNECTED: return "connected";
        case SS_STATUS_BAD_PASSWORD: return "wrong password";
        case SS_STATUS_NOT_FOUND: return "network not found";
        case SS_STATUS_TIMED_OUT: return "timed out";
        case SS_STATUS_LEAVING: return "leaving setup...";
        default: return "unknown";
    }
}

// Builds "code " + code into out, truncating rather than overflowing. Kept as
// a hand-rolled bounded copy, the same way provision_logic.c builds strings,
// rather than pulling in <stdio.h> for one snprintf.
static void build_code_line(char *out, size_t out_size, const char *code) {
    static const char prefix[] = "code ";
    size_t n = 0;
    for (size_t i = 0; prefix[i] != '\0' && n + 1 < out_size; i++) out[n++] = prefix[i];
    for (size_t i = 0; code[i] != '\0' && n + 1 < out_size; i++) out[n++] = code[i];
    out[n] = '\0';
}

void setup_screen_render(uint8_t *fb, const setup_screen_t *s) {
    memset(fb, 0, FACE_FB_BYTES);

    char code_line[SS_LINE_MAX];
    build_code_line(code_line, sizeof(code_line), s->code);

    ss_draw_text(fb, 0, 0, s->ap_name);
    ss_draw_text(fb, 0, 16, s->address);
    ss_draw_text(fb, 0, 32, code_line);
    ss_draw_text(fb, 0, 48, ss_status_text(s->status));
}
